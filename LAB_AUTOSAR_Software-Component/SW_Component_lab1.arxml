AUTOSAR XML (schema 4-2-2)
package /SWC_EABS_PACKAGE
  sensor actuator sw component type LIDAR_SENSOR_SW1
  sensor actuator sw component type SPEED_SENSOR_SW2
  ecu abstraction sw component type ECU_IO_SW3
  application sw component type EABS_APPLICATION_SW4
  parameter sw component type THRESHOLD_d_SW5
  sensor actuator sw component type WARNING_LED_SW6
  complex device driver sw component type URGENT_BRAKING_SW8
  service sw component type SERVICES_SW7
  nv block sw component type NV_FLASH_STORAGE_SW9
